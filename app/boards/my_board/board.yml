## app/boards/my_board/board.yml
```yaml
board:
  name: my_board
  full_name: my board from scratch
  vendor: Madi
  socs:
  - name: esp32
```

## app/boards/our_board/board.yml
```yaml
board:
  name: our_board
  full_name: Our Board
  vendor: Madi
  socs:
  - name: esp32
```

## app/drivers/led_driver/Kconfig
```kconfig
config LED_DRIVER
    bool "Lesson 6 Custom Driver Assignment"
    default y                                          
    depends on DT_HAS_LED_DRIVER_ENABLED         
    help
        enable/disable the custom driver for lesson 6 assignment
```
